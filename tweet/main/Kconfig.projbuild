## tweet/main/Kconfig.projbuild
```kconfig
menu "Config"

config WIFI_SSID
    string "WiFi SSID"
    default "myssid"
    help
	SSID (network name) for the example to connect to.

config WIFI_PASSWORD
    string "WiFi Password"
    default "mypassword"
    help
	WiFi password (WPA or WPA2) for the example to use.

config TWEET_TOKEN
    string "TWEET Token by StewGate U"
    default "mytweettoken"
    help
	StewGate U Token [http://stewgate-u.appspot.com/]

endmenu
```
